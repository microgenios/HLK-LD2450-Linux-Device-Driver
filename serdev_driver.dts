/dts-v1/;
/plugin/;

/ {
    compatible = "ti,beaglebone-black";

    fragment@0 {
        target = <&uart4>; // Altere para a UART do seu sistema (ex: /dev/ttySX)
        __overlay__ {
            status = "okay";
            pinctrl-names = "default";
            pinctrl-0 = <&uart4_pins>;
            hlk_ld2450 {
                compatible = "hlk,ld2450";
                current-speed = <115200>;
            };
        };
    };
};